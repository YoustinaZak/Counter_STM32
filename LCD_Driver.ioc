# file: LCD_Driver.ioc
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Mcu.Family=STM32F1
Mcu.Name=STM32F103C(8-B)Tx
Mcu.Package=LQFP48
NVIC.PriorityGroup=NVIC_PRIORITYGROUP_4
PA13.Mode=Serial_Wire
PA13.Signal=SYS_JTMS-SWDIO
PA14.Mode=Serial_Wire
PA14.Signal=SYS_JTCK-SWCLK
PD0-OSC_IN.Mode=HSE-External-Oscillator
PD0-OSC_IN.Signal=RCC_OSC_IN
PD1-OSC_OUT.Mode=HSE-External-Oscillator
PD1-OSC_OUT.Signal=RCC_OSC_OUT
ProjectManager.HeapSize=0x200
ProjectManager.StackSize=0x400
ProjectManager.TargetToolchain=STM32CubeIDE
RCC.APB1Freq_Value=8000000
RCC.APB2Freq_Value=8000000
board=custom

// file: Core/Src/main.c
/* USER CODE BEGIN Header */
/**
  ******************************************************************************
  * @file           : main.c
  * @brief          : Main program body
  ******************************************************************************
  * @attention
  *
  * Copyright (c) 2024 STMicroelectronics.
  * All rights reserved.
  *
  * This software is licensed under terms that can be found in the LICENSE file
  * in the root directory of this software component.
  * If no LICENSE file comes with this software, it is provided AS-IS.
  *
  ******************************************************************************
  */
/* USER CODE END Header */
#include "main.h"

/* USER CODE BEGIN PV */
Alcd_t lcd1={
		.Data_GPIO=GPIOA,
		.Data_GPIO_Start_Pin=0,
		.RS_GPIO=GPIOA,
		.RS_GPIO_Pin=GPIO_PIN_4,
		.EN_GPIO=GPIOA,
		.EN_GPIO_Pin=GPIO_PIN_5,
};

char stringaya[16];

Keypad_Matrix_t kp={
		.Rows = 4,
		.Columns = 4,
		.Row_Port = GPIOB,
		.Column_Port = GPIOB,
		.Row_Start_Pin = 12,
		.Column_Start_Pin = 6
};
/* USER CODE END PV */

void SystemClock_Config(void);
static void MX_GPIO_Init(void);

int main(void)
{

  /* MCU Configuration--------------------------------------------------------*/

  /* Reset of all peripherals, Initializes the Flash interface and the Systick. */
  HAL_Init();

  /* Configure the system clock */
  SystemClock_Config();

  /* Initialize all configured peripherals */
  MX_GPIO_Init();
  /* USER CODE BEGIN 2 */
  Alcd_Init(& lcd1, 2, 0);

  Alcd_PutAt_n(&lcd1, 1, 0, "Youstina", 8);
  HAL_Delay(3000);

  Alcd_Clear(&lcd1);
  uint8_t HH=0;
  uint8_t MM=0;
  uint8_t SS=0;
  uint16_t mm=0;
  uint8_t length;

  /* USER CODE END 2 */
  __HAL_RCC_GPIOB_CLK_ENABLE();
  Keypad_Matrix_init(&kp);
  /* Infinite loop */
  while (1)
  {
	  Keypad_Matrix_refresh(&kp);
	  if(Keypad_Matrix_ReadKey(&kp, 1))
	  {
		  while(1)
		  {
			  Keypad_Matrix_refresh(&kp);
			  if(Keypad_Matrix_ReadKey(&kp, 2))
			  {
				  while(1)
				  {
					  Keypad_Matrix_refresh(&kp);
					  if(Keypad_Matrix_ReadKey(&kp, 1))
					  {
						  break;
					  }
					  if(Keypad_Matrix_ReadKey(&kp, 3))
					  {
					  	mm=0; SS=0; MM=0; HH=0;
					  	break;
					  }
				  }
			  }
			  if(Keypad_Matrix_ReadKey(&kp, 3))
			  {
				 mm=0; SS=0; MM=0; HH=0;
			  }
			  if(mm>=0 && mm<9)
			  {
				  mm++;
			  }
			  if(mm==9)
			  {
				  SS++;
				  mm=0;
			  }
			  if(SS==59)
			  {
				  MM++;
				  SS=0;
			  }
			  if(MM==59)
			  {
				  HH++;
				  MM=0;
			  }
			  if(HH==59 && MM==59 && SS==59 && mm==1000)
			  {
				  HH=0;
			  }
			  HAL_Delay(100);
			  sprintf(stringaya, "%02d:%02d:%02d.%d", HH, MM, SS, mm);
			  length =sprintf(stringaya, "%02d:%02d:%02d.%d", HH, MM, SS, mm);
			  Alcd_PutAt_n(&lcd1,0, 0, stringaya, length);

		  }
	  }
  }
}

void SystemClock_Config(void)
{
  RCC_OscInitTypeDef RCC_OscInitStruct = {0};
  RCC_ClkInitTypeDef RCC_ClkInitStruct = {0};

  /** Initializes the RCC Oscillators according to the specified parameters
  * in the RCC_OscInitTypeDef structure.
  */
  RCC_OscInitStruct.OscillatorType = RCC_OSCILLATORTYPE_HSI;
  RCC_OscInitStruct.HSIState = RCC_HSI_ON;
  RCC_OscInitStruct.HSICalibrationValue = RCC_HSICALIBRATION_DEFAULT;
  RCC_OscInitStruct.PLL.PLLState = RCC_PLL_NONE;
  if (HAL_RCC_OscConfig(&RCC_OscInitStruct) != HAL_OK)
  {
    Error_Handler();
  }

  /** Initializes the CPU, AHB and APB buses clocks
  */
  RCC_ClkInitStruct.ClockType = RCC_CLOCKTYPE_HCLK|RCC_CLOCKTYPE_SYSCLK
                              |RCC_CLOCKTYPE_PCLK1|RCC_CLOCKTYPE_PCLK2;
  RCC_ClkInitStruct.SYSCLKSource = RCC_SYSCLKSOURCE_HSI;
  RCC_ClkInitStruct.AHBCLKDivider = RCC_SYSCLK_DIV1;
  RCC_ClkInitStruct.APB1CLKDivider = RCC_HCLK_DIV1;
  RCC_ClkInitStruct.APB2CLKDivider = RCC_HCLK_DIV1;

  if (HAL_RCC_ClockConfig(&RCC_ClkInitStruct, FLASH_LATENCY_0) != HAL_OK)
  {
    Error_Handler();
  }
}

static void MX_GPIO_Init(void)
{

  /* GPIO Ports Clock Enable */
  __HAL_RCC_GPIOD_CLK_ENABLE();
  __HAL_RCC_GPIOA_CLK_ENABLE();

}

void Error_Handler(void)
{
  __disable_irq();
  while (1)
  {
  }
}
